## arch/arm64/configs/pegasus_defconfig
```kconfig
# CONFIG_LOCALVERSION_AUTO is not set
# CONFIG_SWAP is not set
CONFIG_SYSVIPC=y
# CONFIG_CROSS_MEMORY_ATTACH is not set
CONFIG_HIGH_RES_TIMERS=y
CONFIG_IKCONFIG=y
CONFIG_IKCONFIG_PROC=y
CONFIG_LOG_BUF_SHIFT=20
CONFIG_CGROUPS=y
CONFIG_CGROUP_FREEZER=y
CONFIG_CGROUP_DEVICE=y
CONFIG_CPUSETS=y
CONFIG_CGROUP_CPUACCT=y
CONFIG_MEMCG=y
CONFIG_MEMCG_KMEM=y
CONFIG_CGROUP_PERF=y
CONFIG_CGROUP_SCHED=y
CONFIG_BLK_CGROUP=y
CONFIG_USER_NS=y
CONFIG_RELAY=y
CONFIG_BLK_DEV_INITRD=y
# CONFIG_COMPAT_BRK is not set
CONFIG_PROFILING=y
CONFIG_MODULES=y
CONFIG_MODULE_UNLOAD=y
# CONFIG_IOSCHED_DEADLINE is not set
# CONFIG_IOSCHED_CFQ is not set
CONFIG_ARCH_BCM_IPROC=y
CONFIG_PCI=y
CONFIG_PCI_MSI=y
CONFIG_NR_CPUS=5
CONFIG_HOTPLUG_CPU=y
# CONFIG_SPARSEMEM_VMEMMAP is not set
# CONFIG_COMPACTION is not set
# CONFIG_BOUNCE is not set
# CONFIG_EFI is not set
CONFIG_BINFMT_MISC=y
CONFIG_COMPAT=y
# CONFIG_SUSPEND is not set
CONFIG_NET=y
CONFIG_PACKET=y
CONFIG_UNIX=y
CONFIG_INET=y
CONFIG_IP_PNP=y
CONFIG_IP_PNP_DHCP=y
CONFIG_IP_PNP_BOOTP=y
CONFIG_NETFILTER=y
CONFIG_BRIDGE=y
CONFIG_DEVTMPFS=y
CONFIG_DEVTMPFS_MOUNT=y
# CONFIG_STANDALONE is not set
# CONFIG_PREVENT_FIRMWARE_BUILD is not set
# CONFIG_FIRMWARE_IN_KERNEL is not set
CONFIG_MTD_CMDLINE_PARTS=y
CONFIG_MTD_BLOCK=y
CONFIG_MTD_NAND=y
CONFIG_MTD_NAND_BRCMNAND=y
CONFIG_MTD_UBI=y
CONFIG_EEPROM_AT25=y
CONFIG_BLK_DEV_SD=y
CONFIG_CHR_DEV_SG=y
CONFIG_SCSI_CONSTANTS=y
CONFIG_SCSI_LOGGING=y
# CONFIG_SCSI_LOWLEVEL is not set
CONFIG_ATA=y
CONFIG_SATA_AHCI=y
CONFIG_SATA_AHCI_PLATFORM=y
# CONFIG_ATA_SFF is not set
CONFIG_MD=y
CONFIG_BLK_DEV_MD=y
CONFIG_MD_RAID0=y
CONFIG_MD_RAID1=y
CONFIG_MD_RAID10=y
CONFIG_MD_RAID456=y
CONFIG_NETDEVICES=y
# CONFIG_BGMAC_PLATFORM is not set
CONFIG_NET_BCM_AMAC=y
CONFIG_PHYLIB=y
CONFIG_FIXED_PHY=y
# CONFIG_INPUT_MOUSEDEV is not set
# CONFIG_INPUT_KEYBOARD is not set
# CONFIG_INPUT_MOUSE is not set
# CONFIG_SERIO is not set
# CONFIG_LEGACY_PTYS is not set
# CONFIG_DEVKMEM is not set
CONFIG_SERIAL_8250=y
CONFIG_SERIAL_8250_CONSOLE=y
CONFIG_SERIAL_8250_DW=y
CONFIG_HW_RANDOM=y
CONFIG_I2C=y
CONFIG_I2C_CHARDEV=y
CONFIG_I2C_MUX=y
CONFIG_I2C_MUX_PCA954x=y
CONFIG_SPI=y
CONFIG_SPI_PL022=y
CONFIG_SPI_SPIDEV=y
CONFIG_GPIO_SYSFS=y
CONFIG_GPIO_PCA953X=y
CONFIG_GPIO_PCF857X=y
# CONFIG_HWMON is not set
CONFIG_WATCHDOG=y
CONFIG_ARM_SP805_WATCHDOG=y
CONFIG_MFD_SYSCON=y
CONFIG_REGULATOR=y
CONFIG_REGULATOR_GPIO=y
CONFIG_SOUND=y
CONFIG_SND=y
CONFIG_SND_DYNAMIC_MINORS=y
# CONFIG_SND_USB is not set
CONFIG_SND_SOC=m
CONFIG_SND_SOC_PEGASUS=m
CONFIG_SND_SOC_PEGASUS_AUDIO_MACHINE=m
CONFIG_USB=y
CONFIG_USB_ANNOUNCE_NEW_DEVICES=y
CONFIG_USB_DYNAMIC_MINORS=y
CONFIG_USB_XHCI_HCD=y
CONFIG_USB_XHCI_PLATFORM=y
CONFIG_USB_STORAGE=y
CONFIG_MMC=y
CONFIG_MMC_SDHCI=y
CONFIG_MMC_SDHCI_PLTFM=y
CONFIG_NEW_LEDS=y
CONFIG_LEDS_CLASS=y
CONFIG_RTC_CLASS=y
CONFIG_DMADEVICES=y
CONFIG_PL330_DMA=y
# CONFIG_COMMON_CLK_XGENE is not set
# CONFIG_ARM_ARCH_TIMER_EVTSTREAM is not set
CONFIG_ARM_TIMER_SP804=y
CONFIG_MAILBOX=y
CONFIG_ARM_SMMU=y
CONFIG_PWM=y
CONFIG_PWM_BCM_IPROC=y
# CONFIG_PHY_STINGRAY_PCIE_PRBS is not set
# CONFIG_PHY_NS2_USB3 is not set
# CONFIG_PHY_NSP_USB3 is not set
CONFIG_EXT2_FS=y
CONFIG_EXT2_FS_XATTR=y
CONFIG_EXT4_FS=y
# CONFIG_DNOTIFY is not set
CONFIG_MSDOS_FS=y
CONFIG_VFAT_FS=y
CONFIG_TMPFS=y
CONFIG_HUGETLBFS=y
CONFIG_CONFIGFS_FS=m
CONFIG_UBIFS_FS=y
CONFIG_UBIFS_FS_ADVANCED_COMPR=y
CONFIG_NFS_FS=y
CONFIG_NFS_V3_ACL=y
CONFIG_NFS_V4=y
CONFIG_NFS_V4_1=y
CONFIG_NFS_V4_2=y
CONFIG_NFS_V4_1_MIGRATION=y
CONFIG_ROOT_NFS=y
CONFIG_NLS_CODEPAGE_437=y
CONFIG_NLS_ISO8859_1=y
CONFIG_PRINTK_TIME=y
CONFIG_MESSAGE_LOGLEVEL_DEFAULT=7
# CONFIG_ENABLE_WARN_DEPRECATED is not set
# CONFIG_ENABLE_MUST_CHECK is not set
CONFIG_MAGIC_SYSRQ=y
CONFIG_MAGIC_SYSRQ_DEFAULT_ENABLE=0xA
CONFIG_FTRACE=y
CONFIG_FUNCTION_TRACER=y
# CONFIG_FUNCTION_GRAPH_TRACER is not set
# CONFIG_TRACING_EVENTS_GPIO is not set
CONFIG_CRYPTO_PCRYPT=m
CONFIG_CRYPTO_AUTHENC=y
CONFIG_CRYPTO_TEST=m
CONFIG_CRYPTO_CCM=y
CONFIG_CRYPTO_GCM=y
CONFIG_CRYPTO_CBC=y
CONFIG_CRYPTO_ECB=y
CONFIG_CRYPTO_XTS=y
CONFIG_CRYPTO_CMAC=y
CONFIG_CRYPTO_XCBC=y
CONFIG_CRYPTO_MD5=y
CONFIG_CRYPTO_SHA1=y
CONFIG_CRYPTO_SHA512=y
CONFIG_CRYPTO_ARC4=y
CONFIG_CRYPTO_DES=y
CONFIG_CRYPTO_ANSI_CPRNG=y
CONFIG_ARM64_CRYPTO=y
CONFIG_CRYPTO_SHA1_ARM64_CE=y
CONFIG_CRYPTO_SHA2_ARM64_CE=y
CONFIG_CRYPTO_GHASH_ARM64_CE=y
CONFIG_CRYPTO_AES_ARM64_CE_CCM=y
CONFIG_CRYPTO_AES_ARM64_CE_BLK=y
CONFIG_CRYPTO_AES_ARM64_NEON_BLK=y
```

## drivers/misc/synce/Kconfig
```kconfig
menu "SyncE Support"

config BCM_NS2_SYNCE
	tristate "Broadcom NS2 SyncE support"
	depends on ARCH_BCM_IPROC
	help
	  Add Synchronous Ethernet (SyncE) driver support for Broadcom
	  Northstar2 platform.

	  If unsure, say N.

config BCM_NSP_SYNCE
	tristate "Broadcom NSP SyncE support"
	depends on ARCH_BCM_IPROC
	help
	  Add Synchronous Ethernet (SyncE) driver support for Broadcom
	  Northstar Plus platform.

	  If unsure, say N.

endmenu
```

## drivers/mtd/spi-nor/Kconfig
```kconfig
menuconfig MTD_SPI_NOR
	tristate "SPI-NOR device support"
	depends on MTD
	help
	  This is the framework for the SPI NOR which can be used by the SPI
	  device drivers and the SPI-NOR device driver.

if MTD_SPI_NOR

config MTD_SPI_NOR_USE_4K_SECTORS
	bool "Use small 4096 B erase sectors"
	default y
	help
	  Many flash memories support erasing small (4096 B) sectors. Depending
	  on the usage this feature may provide performance gain in comparison
	  to erasing whole blocks (32/64 KiB).
	  Changing a small part of the flash's contents is usually faster with
	  small sectors. On the other hand erasing should be faster when using
	  64 KiB block instead of 16 × 4 KiB sectors.

	  Please note that some tools/drivers/filesystems may not work with
	  4096 B erase size (e.g. UBIFS requires 15 KiB as a minimum).

config SPI_FSL_QUADSPI
	tristate "Freescale Quad SPI controller"
	depends on ARCH_MXC || COMPILE_TEST
	depends on HAS_IOMEM
	help
	  This enables support for the Quad SPI controller in master mode.
	  This controller does not support generic SPI. It only supports
	  SPI NOR.

config SPI_NXP_SPIFI
	tristate "NXP SPI Flash Interface (SPIFI)"
	depends on OF && (ARCH_LPC18XX || COMPILE_TEST)
	depends on HAS_IOMEM
	help
	  Enable support for the NXP LPC SPI Flash Interface controller.

	  SPIFI is a specialized controller for connecting serial SPI
	  Flash. Enable this option if you have a device with a SPIFI
	  controller and want to access the Flash as a mtd device.

config SPI_DISABLE_DEFAULT_FOUR_BYTE_MODE
	bool "Disable default four byte mode"
	default y
	help
	  Many flash memories supports 3 byte and 4 byte addressing. Linux spi
	  driver defaults to 4 byte addressing mode if flash size is more than
	   16M.
	  At power on, the flash will be in 3 byte mode by default and SOC tries
	  to read using 3 byte mode. If linux used soft reboot with 4 byte bode,
	  there will be conflict(SOC expects in 3 byte mode). This feature
	  enable the four byte mode when flash is accessed and puts back in to
	  three byte bode after completion of activity.

endif # MTD_SPI_NOR
```

## net/dsa/Kconfig
```kconfig
config HAVE_NET_DSA
	def_bool y
	depends on NETDEVICES && !S390

# Drivers must select NET_DSA and the appropriate tagging format

config NET_DSA
	tristate "Distributed Switch Architecture"
	depends on HAVE_NET_DSA && NET_SWITCHDEV
	select PHYLIB
	---help---
	  Say Y if you want to enable support for the hardware switches supported
	  by the Distributed Switch Architecture.

if NET_DSA

config NET_DSA_HWMON
	bool "Distributed Switch Architecture HWMON support"
	default y
	depends on HWMON && !(NET_DSA=y && HWMON=m)
	---help---
	  Say Y if you want to expose thermal sensor data on switches supported
	  by the Distributed Switch Architecture.

	  Some of those switches contain thermal sensors. This data is available
	  via the hwmon sysfs interface and exposes the onboard sensors.

# tagging formats
config NET_DSA_TAG_BRCM
	bool

config NET_DSA_TAG_BRCM_PREPEND
	bool "CPU interface prepend brcm header"
	depends on NET_DSA_TAG_BRCM
	help
	  Select this option to prepend broadcom tags on packets transmitted to
	  the CPU port.  By default when NET_DSA_TAG_BRCM is enabled the broadcom
	  tag is added after the DA/SA portion of the packet.  Prepending the
	  broadcom tag is supported only on specific hardware.

config NET_DSA_TAG_DSA
	bool

config NET_DSA_TAG_EDSA
	bool

config NET_DSA_TAG_TRAILER
	bool

endif
```

## sound/soc/broadcom/ns2/Kconfig
```kconfig
config SND_SOC_NORTHSTAR2
	tristate "SoC platform audio for Broadcom NORTHSTAR2 chips"
	depends on HAS_IOMEM
	help
	  Say Y if you want to add support for SoC audio on Broadcom APs

	  If you don't know what to do here, say N.

config SND_SOC_NORTHSTAR2_SSP
	depends on SND_SOC_NORTHSTAR2
	tristate

config SND_SOC_SI3226X
	depends on SND_SOC_NORTHSTAR2
        tristate

config SND_SOC_NORTHSTAR2_AUDIO_MACHINE
	tristate "SoC Audio support for Broadcom NORTHSTAR2 dev board with SiLabs/TI module"
	depends on SND_SOC_NORTHSTAR2
	select SND_SOC_NORTHSTAR2_SSP
	select SND_SOC_SI3226X
	select SND_SOC_TLV320AIC3X
	help
	  Say Y if you want to add support for NORTHSTAR2 SoC voip audio on
	  development boards (958710K, 958712K)
```

## sound/soc/broadcom/pegasus/Kconfig
```kconfig
config SND_SOC_PEGASUS
	tristate "SoC platform audio for Broadcom PEGASUS chips"
	#depends on HAS_IOMEM
	help
	  Say Y if you want to add support for SoC audio on Broadcom APs

	  If you don't know what to do here, say N.

config SND_SOC_PEGASUS_SSP
	depends on SND_SOC_PEGASUS
	tristate

config SND_SOC_SI3226X
	depends on SND_SOC_PEGASUS
        tristate

config SND_SOC_PEGASUS_AUDIO_MACHINE
	tristate "SoC Audio support for Broadcom PEGASUS dev board with SiLabs/TI module"
	depends on SND_SOC_PEGASUS
	select SND_SOC_PEGASUS_SSP
	select SND_SOC_SI3226X
	select SND_SOC_TLV320AIC3X
	help
	  Say Y if you want to add support for PEGASUS SoC voip audio on
	  development boards (bcm958543k).
```
