## Documentation/devicetree/bindings/bus/brcm,iproc-idm-monitor.txt
```
Driver for ARM IDM slave wrappers on Broadcom iProc devices

Globally required properties:

- compatible : brcm,iproc-idm-monitor

In addition, at least one IDM slave wrapper description would need
to be provided as a child device.

Per IDM slave wrapper monitor required properties:

- reg : iomem address of this IDM slave wrapper controls
- interrupts : interrupt for this IDM slave wrapper

Per IDM slave wrapper monitor optional properties:

- timeout_exp : Specifies the exponent for the timeout interval.
- timeout_irq : If present, an interrupt is to be triggered on timeout.
- timeout_reset : If present, the slave device will be reset on timeout.
- error_irq : If present, an interrupt is to be triggered on other errors
- error_reset : If present, the slave device will be reset on other errors.

Note that if timeout_exp is not specified for a given slave device, the
wrapper for that device will not issue timeouts.  It is possible for a
hung device, or a device with clock disabled, to halt the entire system
if timeout is not enabled and the device is accessed.  Timeout is in
AXI clocks, 2^timeout_exp.  Once a timeout occurs, the slave will be
considered timed out and further accesses to it will fail, at least until
the device (or the system) is reset.

Enabling interrupts allows faults detected by the IDM slave wrappers to
be reported to the Linux kernel, and so included in the logs.  Since
core accesses will also fault in other ways, this may seem redundant, but
it is possible for other masters to trigger these faults, too, and in
that case, the core may not become aware of them except through the
interrupt mechanism provided here.

Enabling reset is dangerous because this reset is asserted within the
hardware itself.  At this time, there is no proper support for this
feature.  To handle this cleanly, the kernel driver(s) associated with
any downstream devices would need to be told to unconditionally and
immediately remove the associated resources, and then the devices could
be re-enumerated or restarted.  The necessary code is not yet inlcuded
in the IDM slave wrapper fault handling code.

In general, the boot code should enable timeouts for all IDM slave
wrappers.  It is possible that you would not be able to expose some
of them to the kernel due to 'secure' settings, but for all you can
expose to the kernel, you should still set a timeout value.  This is
to avoid accidental hard hangs.  It is strongly recommended to also
enable interrupts for all IDM slave wrappers that the kernel can see.


Example:

        idm {
                compatible = "brcm,iproc-idm-monitor";

                ihost_s1 {
                        reg = <0x18107900 0x00000200>;
                        interrupts = <GIC_SPI 29 IRQ_TYPE_LEVEL_HIGH>;
                        error_irq;
                        timeout_irq;
                        timeout_exp = <31>;
                };

                ddr_s1 {
                        reg = <0x18109900 0x00000200>;
                        interrupts = <GIC_SPI 31 IRQ_TYPE_LEVEL_HIGH>;
                        error_irq;
                        timeout_irq;
                        timeout_exp = <31>;
                };

        };
```

## Documentation/devicetree/bindings/net/brcm,fa2.txt
```
Broadcom FA2 Flow Accelerator Device Tree Bindings
-------------------------------------------------------------

Required properties:
 - compatible:	"brcm,fa2"
 - reg:		Address and length of the FA2 CTF (cut thru fwd) registers,
 - reg-names:	Names of the registers.  Must have "fa-regs"

Optional properties:
- none

Examples:
fa2: accelerator@25c00 {
	compatible = "brcm,fa2";
	reg = <0x025c00 0x200>;
	reg-names = "fa-regs";
};
```

## Documentation/devicetree/bindings/phy/brcm,peg-combo-phy.txt
```
Broadcom Pegasus PCIe/SATA combo PHY

Required bus properties:
- reg: MDIO Bus number for the MDIO interface
- #address-cells: must be 1
- #size-cells: must be 0

Required PHY properties:
- compatible: must be "brcm,peg-combo-phy"
- reg: MDIO Phy ID for the MDIO interface
- device-type: must be either "pcie" or "sata"
- #address-cells: must be 1
- #size-cells: must be 0

Each PCIe/SATA PHY should be a child bus node of "brcm,mdio-mux-iproc" node.


Example:
	mdio_mux_iproc: mdio-mux@22023c {
		compatible = "brcm,mdio-mux-iproc";
		reg = <0x22023c 0x14>;
		#address-cells = <1>;
		#size-cells = <0>;

		mdio@1 {
			reg = <0x1>;
			#address-cells = <1>;
			#size-cells = <0>;

			combo_phy0: combo-phy@0 {
				compatible = "brcm,peg-combo-phy";
				reg = <0x2>;
				#phy-celss = <0>;
				status = "disabled";
			};
		}
		mdio@2 {
			reg = <0x2>;
			#address-cells = <1>;
			#size-cells = <0>;

			combo_phy1: combo-phy@0 {
				compatible = "brcm,peg-combo-phy";
				reg = <0x3>;
				#phy-celss = <0>;
				status = "disabled";
			};
		};
	};

	/* users of the PCIe/SATA phy */
	&mdio_mux_iproc {
		..
		..
		mdio@1 {
			combo_phy0: combo-phy@0 {
				device-type = "pcie";
				status = "ok";
			};
		};
		mdio@2 {
			combo_phy1: combo-phy@0 {
				device-type = "sata";
				status = "ok";
			};
		};
	};
	..
	..

	&pcie1 {
		phys = <&combo_phy0>;
		status = "ok";
	};
```

## Documentation/devicetree/bindings/phy/brcm,peg-pcie-phy.txt
```
Broadcom Pegasus PCIe PHY

Required bus properties:
- reg: MDIO Bus number for the MDIO interface
- #address-cells: must be 1
- #size-cells: must be 0

Required PHY properties:
- compatible: must be "brcm,peg-pcie-phy"
- reg: MDIO Phy ID for the MDIO interface
- #address-cells: must be 1
- #size-cells: must be 0

Each PCIe PHY should be a child bus node of "brcm,mdio-mux-iproc" node.


Example:
	mdio_mux_iproc: mdio-mux@22023c {
		compatible = "brcm,mdio-mux-iproc";
		reg = <0x22023c 0x14>;
		#address-cells = <1>;
		#size-cells = <0>;

		mdio@0 {
			reg = <0x0>;
			#address-cells = <1>;
			#size-cells = <0>;

			pci_phy0: pci-phy@0 {
				compatible = "brcm,peg-pcie-phy";
				reg = <0x0>;
				#phy-celss = <0>;
				status = "disabled";
			};
		}
	};

	/* users of the PCIe phy */
	&mdio_mux_iproc {
		..
		..
		mdio@0 {
			pci_phy0: pci-phy@0 {
				status = "ok";
			};
		};
	};
	..
	..

	&pcie0 {
		phys = <&pci_phy0>;
		status = "ok";
	};
```

## Documentation/devicetree/bindings/pinctrl/brcm,pegasus-pinmux.txt
```
Broadcom Pegasus IOMUX Controller

The Pegasus IOMUX controller supports group based mux configuration. There
are some individual pins that support modifying the pinconf parameters.

Required properties:

- compatible:
    Must be "brcm,pegasus-pinmux"

- reg:
    Define the base and range of the I/O address space that contains the
    Pegasus IOMUX and pin configuration registers.

Properties in sub nodes:

- function:
    The mux function to select

- groups:
    The list of groups to select with a given function

- pins:
    List of pin names to change configuration

The generic properties bias-disable, bias-pull-down, bias-pull-up,
drive-strength, slew-rate, input-enable, input-disable are supported
for some individual pins listed at the end.

For more details, refer to
Documentation/devicetree/bindings/pinctrl/pinctrl-bindings.txt

For example:

	pinctrl: pinctrl@00200aa0 {
		compatible = "brcm,pegasus-pinmux";
		reg = <0x00200aa0 0x04>,
		      <0x204f000c 0x04>,
		      <0x002009b0 0xB0>;

		pinctrl-names = "default";
		pinctrl-0 = <&nand_sel &sflash_wp>;

		/* Select nand function */
		nand_sel: nand_sel {
			function = "nand";
			groups = "nand_grp";
		};

		/* Pull up the sflash_wp_n pin */
		sflash_wp: sflash_wp_n {
			pins = "sflash_wp_n";
			bias-pull-up;
		};
	};

List of supported functions and groups in Pegasus:

"spi_grps": "spi0_grp", "spi1_grp"

"uart_grps": "uart1_in_out_grp", "uart1_cts_rts_grp", "uart2_grp",
	"uart3_grp", "uart1_ext_clk_grp"

"nand": "nand_grp"

"emmc_grps": "emmc_mfio_14_26_grp", "emmc_mfio_27_39_grp"

"sdio_grps": "sdio_mfio_14_19_grp", "sdio_mfio_27_32_grp"

"mdio_grps": "mdio_grp"

"gpio": "gpio_0_3_grp", "gpio_7_9_grp", "gpio_6_8_grp", "gpio_10_11_grp",
	"gpio_12_13_grp", "gpio_14_15", "gpio_16_19_grp", "gpio_4_5_0_grp",
	"gpio_16_19_mfio_33_36_grp", "gpio_20_21_grp", "gpio_22_25_grp",
	"gpio_26_27_grp", "gpio_28_31_grp", "gpio_28_30_grp",
	"gpio_28_29_grp", "gpio_30_31_grp"

"sgpio_grps": "sgpio_mfio_51_54_grp", "sgpio_mfio_55_58_grp"

"audio_grps": "audio_mfio_45_48_grp", "audio_mfio_51_54_grp"

"pwm_grps": "pwm_0_1_grp", "pwm_2_3_grp"

"parled_grps": "parallel_led_grp"

"serled_grps": "serial_led_grp"

"synce_grps": "synce_output_mfio_4_5_grp", "synce_input_mfio_10_11_grp",
	"synce_input_mfio_12_13_grp", "synce_output_mfio_10_11_grp",
	"synce_output_mfio_12_13_grp"

"timesync_grps": "time_sync_input_mfio_6_7_grp",
	"time_sync_output_mfio_4_5_grp", "time_sync_output_mfio_6_7_grp",
	"time_sync_input_mfio_43_44_grp", "time_sync_output_mfio_43_44_grp",
	"time_sync_input_mfio_49_50_grp", "time_sync_output_mfio_49_50_grp"


List of pins that support pinconf parameters:

"mfio_0" to "mfio_62"
"sflash_clk", "sflash_cs_I", "sflash_mosi", "sflash_miso", "sflash_wp_n",
"sflash_hold_n", "dstrap_bit3", "dstrap_bit4", "i2c1_scl", "i2c1_sda",
"i2c2_scl", "i2c2_sda", "i2c3_scl", "i2c3_sda", "i2s_ws_0", "i2s_sdout_0",
"i2s_sdin_0", "i2s_bitclk_0", "i2s_mclk_0", "i2s_ws_1", "i2s_sdout_1",
"i2s_sdin_1", "i2s_bitclk_1", "i2s_mclk_1", "i2s_ws_2", "i2s_sdout_2",
"i2s_sdin_2", "i2s_bitclk_2", "i2s_mclk_2", "pcie0_perstb", "pcie1_perstb",
"pcie2_perstb", "usb3_vbus_ppc", "usb2_vbus_ppc", "usb3_vbus_ovc",
"usb2_vbus_ovc"
```

## arch/arm/configs/bcm_ns_defconfig
```kconfig
CONFIG_KERNEL_XZ=y
# CONFIG_SWAP is not set
CONFIG_SYSVIPC=y
CONFIG_NO_HZ_IDLE=y
CONFIG_HIGH_RES_TIMERS=y
CONFIG_BSD_PROCESS_ACCT=y
CONFIG_BSD_PROCESS_ACCT_V3=y
CONFIG_IKCONFIG=y
CONFIG_IKCONFIG_PROC=y
CONFIG_LOG_BUF_SHIFT=19
CONFIG_CGROUPS=y
CONFIG_CGROUP_FREEZER=y
CONFIG_CGROUP_DEVICE=y
CONFIG_CGROUP_CPUACCT=y
CONFIG_CGROUP_SCHED=y
CONFIG_BLK_CGROUP=y
CONFIG_NAMESPACES=y
CONFIG_BLK_DEV_INITRD=y
CONFIG_SYSCTL_SYSCALL=y
CONFIG_EMBEDDED=y
CONFIG_PERF_EVENTS=y
# CONFIG_COMPAT_BRK is not set
CONFIG_JUMP_LABEL=y
CONFIG_MODULES=y
CONFIG_MODULE_UNLOAD=y
# CONFIG_BLK_DEV_BSG is not set
CONFIG_PARTITION_ADVANCED=y
CONFIG_ARCH_BCM=y
CONFIG_ARCH_BCM_5301X=y
CONFIG_ARM_THUMBEE=y
CONFIG_PCI=y
CONFIG_PCI_MSI=y
CONFIG_PCI_DEBUG=y
CONFIG_SMP=y
CONFIG_NR_CPUS=2
CONFIG_PREEMPT=y
CONFIG_AEABI=y
CONFIG_HIGHMEM=y
# CONFIG_COMPACTION is not set
# CONFIG_ATAGS is not set
CONFIG_ZBOOT_ROM_TEXT=0x0
CONFIG_ZBOOT_ROM_BSS=0x0
CONFIG_ARM_APPENDED_DTB=y
CONFIG_CPU_IDLE=y
CONFIG_NET=y
CONFIG_PACKET=y
CONFIG_UNIX=y
CONFIG_INET=y
CONFIG_IP_MULTICAST=y
CONFIG_IP_ADVANCED_ROUTER=y
CONFIG_IP_MULTIPLE_TABLES=y
CONFIG_IP_ROUTE_MULTIPATH=y
CONFIG_IP_ROUTE_VERBOSE=y
CONFIG_IP_PNP=y
CONFIG_IP_PNP_DHCP=y
CONFIG_IP_MROUTE=y
CONFIG_IP_MROUTE_MULTIPLE_TABLES=y
CONFIG_SYN_COOKIES=y
# CONFIG_INET_XFRM_MODE_TRANSPORT is not set
# CONFIG_INET_XFRM_MODE_TUNNEL is not set
# CONFIG_INET_XFRM_MODE_BEET is not set
# CONFIG_INET_LRO is not set
# CONFIG_INET_DIAG is not set
CONFIG_TCP_CONG_ADVANCED=y
# CONFIG_TCP_CONG_BIC is not set
# CONFIG_TCP_CONG_WESTWOOD is not set
# CONFIG_TCP_CONG_HTCP is not set
# CONFIG_INET6_XFRM_MODE_TRANSPORT is not set
# CONFIG_INET6_XFRM_MODE_TUNNEL is not set
# CONFIG_INET6_XFRM_MODE_BEET is not set
# CONFIG_IPV6_SIT is not set
CONFIG_IPV6_MULTIPLE_TABLES=y
CONFIG_IPV6_SUBTREES=y
CONFIG_IPV6_MROUTE=y
CONFIG_NETFILTER=y
# CONFIG_BRIDGE_NETFILTER is not set
CONFIG_NF_CONNTRACK=y
# CONFIG_NF_CONNTRACK_PROCFS is not set
CONFIG_NF_CONNTRACK_FTP=y
CONFIG_NF_CONNTRACK_IPV4=y
CONFIG_NF_NAT_IPV4=y
CONFIG_IP_NF_IPTABLES=y
CONFIG_IP_NF_FILTER=y
CONFIG_IP_NF_TARGET_REJECT=y
CONFIG_IP_NF_MANGLE=y
CONFIG_IP_NF_RAW=y
CONFIG_BRIDGE=y
# CONFIG_BRIDGE_IGMP_SNOOPING is not set
CONFIG_BRIDGE_VLAN_FILTERING=y
CONFIG_NET_DSA=y
CONFIG_VLAN_8021Q=y
CONFIG_NET_SCHED=y
CONFIG_NET_SCH_FQ_CODEL=y
CONFIG_NET_SWITCHDEV=y
CONFIG_DEVTMPFS=y
CONFIG_DEVTMPFS_MOUNT=y
# CONFIG_FIRMWARE_IN_KERNEL is not set
CONFIG_MTD_CMDLINE_PARTS=y
CONFIG_MTD_BLOCK=y
CONFIG_MTD_NAND=y
CONFIG_MTD_NAND_BRCMNAND=y
# CONFIG_MTD_SPI_NOR_USE_4K_SECTORS is not set
CONFIG_MTD_UBI=y
CONFIG_MTD_UBI_BEB_LIMIT=2
CONFIG_EEPROM_AT24=y
CONFIG_BLK_DEV_SD=y
CONFIG_CHR_DEV_SG=y
CONFIG_SCSI_CONSTANTS=y
CONFIG_SCSI_LOGGING=y
CONFIG_ATA=y
CONFIG_SATA_AHCI=y
CONFIG_SATA_AHCI_PLATFORM=y
CONFIG_ATA_GENERIC=y
CONFIG_MD=y
CONFIG_BLK_DEV_MD=y
CONFIG_MD_LINEAR=y
CONFIG_MD_RAID0=y
CONFIG_MD_RAID1=y
CONFIG_MD_RAID10=y
CONFIG_MD_RAID456=y
CONFIG_MD_MULTIPATH=y
CONFIG_MD_FAULTY=y
CONFIG_NETDEVICES=y
CONFIG_TUN=y
CONFIG_B53=y
CONFIG_B53_SRAB_DRIVER=y
CONFIG_B53_CPU_TAG=y
# CONFIG_NET_CADENCE is not set
CONFIG_BGMAC_BCMA=y
# CONFIG_BGMAC_PLATFORM is not set
# CONFIG_NET_VENDOR_CIRRUS is not set
# CONFIG_NET_VENDOR_FARADAY is not set
# CONFIG_NET_VENDOR_INTEL is not set
# CONFIG_NET_VENDOR_MARVELL is not set
# CONFIG_NET_VENDOR_MICREL is not set
# CONFIG_NET_VENDOR_NATSEMI is not set
# CONFIG_NET_VENDOR_SEEQ is not set
# CONFIG_NET_VENDOR_SMSC is not set
# CONFIG_NET_VENDOR_STMICRO is not set
# CONFIG_NET_VENDOR_WIZNET is not set
CONFIG_FIXED_PHY=y
# CONFIG_INPUT_MOUSEDEV is not set
# CONFIG_KEYBOARD_ATKBD is not set
# CONFIG_INPUT_MOUSE is not set
# CONFIG_SERIO is not set
# CONFIG_LEGACY_PTYS is not set
CONFIG_SERIAL_8250=y
# CONFIG_SERIAL_8250_DEPRECATED_OPTIONS is not set
CONFIG_SERIAL_8250_CONSOLE=y
CONFIG_SERIAL_8250_NR_UARTS=2
CONFIG_SERIAL_8250_RUNTIME_UARTS=2
CONFIG_SERIAL_8250_DW=y
CONFIG_SERIAL_OF_PLATFORM=y
CONFIG_HW_RANDOM=y
CONFIG_I2C_CHARDEV=y
# CONFIG_I2C_HELPER_AUTO is not set
CONFIG_I2C_SMBUS=y
CONFIG_SPI=y
CONFIG_GPIO_SYSFS=y
CONFIG_POWER_SUPPLY=y
CONFIG_POWER_RESET=y
CONFIG_POWER_RESET_GPIO_RESTART=y
CONFIG_POWER_RESET_SYSCON=y
CONFIG_SENSORS_LM90=y
CONFIG_WATCHDOG=y
CONFIG_ARM_SP805_WATCHDOG=y
CONFIG_BCM47XX_WDT=y
CONFIG_BCMA_HOST_SOC=y
CONFIG_REGULATOR=y
CONFIG_REGULATOR_FIXED_VOLTAGE=y
CONFIG_REGULATOR_GPIO=y
CONFIG_MEDIA_SUPPORT=y
CONFIG_MEDIA_CAMERA_SUPPORT=y
CONFIG_MEDIA_USB_SUPPORT=y
CONFIG_USB_VIDEO_CLASS=y
# CONFIG_USB_GSPCA is not set
CONFIG_USB=y
CONFIG_USB_ANNOUNCE_NEW_DEVICES=y
CONFIG_USB_XHCI_HCD=y
CONFIG_USB_XHCI_PLATFORM=y
CONFIG_USB_EHCI_HCD=y
CONFIG_USB_EHCI_ROOT_HUB_TT=y
CONFIG_USB_OHCI_HCD=y
CONFIG_USB_HCD_BCMA=y
CONFIG_USB_STORAGE=y
CONFIG_MMC=y
CONFIG_MMC_SDHCI=y
CONFIG_MMC_SDHCI_PLTFM=y
CONFIG_RTC_CLASS=y
CONFIG_RTC_DRV_M41T80=y
CONFIG_STAGING=y
CONFIG_ARM_TIMER_SP804=y
CONFIG_MAILBOX=y
CONFIG_PWM=y
CONFIG_PHY_BCM_NS_USB2=y
CONFIG_PHY_BCM_NS_USB3=y
# CONFIG_PHY_STINGRAY_PCIE_PRBS is not set
# CONFIG_PHY_NS2_PCIE is not set
# CONFIG_PHY_NS2_USB3 is not set
# CONFIG_PHY_NS2_USB_DRD is not set
CONFIG_EXT4_FS=y
CONFIG_AUTOFS4_FS=y
CONFIG_MSDOS_FS=y
CONFIG_VFAT_FS=y
CONFIG_NTFS_FS=y
CONFIG_TMPFS=y
CONFIG_TMPFS_POSIX_ACL=y
CONFIG_JFFS2_FS=y
CONFIG_UBIFS_FS=y
CONFIG_UBIFS_FS_ADVANCED_COMPR=y
CONFIG_NFS_FS=y
CONFIG_ROOT_NFS=y
CONFIG_NLS_CODEPAGE_437=y
CONFIG_NLS_ISO8859_1=y
CONFIG_NLS_UTF8=y
CONFIG_PRINTK_TIME=y
CONFIG_DEBUG_INFO=y
CONFIG_STRIP_ASM_SYMS=y
CONFIG_DEBUG_FS=y
CONFIG_MAGIC_SYSRQ=y
# CONFIG_SCHED_DEBUG is not set
# CONFIG_DEBUG_PREEMPT is not set
# CONFIG_DEBUG_BUGVERBOSE is not set
# CONFIG_ARM_UNWIND is not set
CONFIG_DEBUG_USER=y
CONFIG_CRYPTO_CRYPTD=y
CONFIG_CRYPTO_AUTHENC=y
CONFIG_CRYPTO_TEST=m
CONFIG_CRYPTO_CCM=y
CONFIG_CRYPTO_GCM=y
CONFIG_CRYPTO_CBC=y
CONFIG_CRYPTO_ECB=y
CONFIG_CRYPTO_XTS=y
CONFIG_CRYPTO_XCBC=y
CONFIG_CRYPTO_MD5=y
CONFIG_CRYPTO_SHA1=y
CONFIG_CRYPTO_SHA512=y
CONFIG_CRYPTO_ARC4=y
CONFIG_CRYPTO_DES=y
CONFIG_CRYPTO_ANSI_CPRNG=y
```
